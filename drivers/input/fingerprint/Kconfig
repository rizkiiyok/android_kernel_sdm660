## drivers/input/fingerprint/Kconfig
```kconfig
#
# Fingerprint driver configuration
#

config FINGERPRINT_KEY_FILTER
	bool "Fingerprint Key Filter interface"
	default n
	help

	  If unsure, say N.

menuconfig INPUT_FINGERPRINT
	bool "Fingerprints"
	help
	  Say Y here, and a list of supported fingerprints will be displayed.
	  This option doesn't affect the kernel.

	  If unsure, say Y.

if INPUT_FINGERPRINT
source "drivers/input/fingerprint/fpc/Kconfig"
source "drivers/input/fingerprint/fpc_clover/Kconfig"
source "drivers/input/fingerprint/goodix/Kconfig"
endif

if MACH_ASUS_X01BD

menuconfig INPUT_FINGERPRINT
	bool "Fingerprint"
	help
	  Say Y here, and a list of supported fingerprint will be displayed.
	  This option doesn't affect the kernel.

	  If unsure, say Y.

if INPUT_FINGERPRINT

config CDFINGER_FP
	bool "Fingerprint cdfinger"
	help
	  Say Y here if you use common fp.
	  If unsure, say N.

config FOCALTECH_FP
	bool "Fingerprint focaltech"
	help
	  Say Y here if you use focaltech fp.
	  If unsure, say N.

endif

endif
```

## drivers/platform/asus/Kconfig
```kconfig
menu "Asus Machine"

config MACH_ASUS
	bool "ASUS devices"
	help
	  This enables support for ASUS devices.

config MACH_ASUS_SDM660
	bool
	prompt "ASUS device"
	default MACH_ASUS_DUMMY

config MACH_ASUS_DUMMY
	bool "Dummy device"
	help
	  A stub configuration that doesn't enable support for anything.

config MACH_ASUS_X01BD
	bool "ZenFone Max Pro (M2)"
	select MACH_ASUS_SDM660
	help
	  This enables support for ASUS ZenFone Max Pro (M2).

endmenu

menu "Common"

endmenu
```
